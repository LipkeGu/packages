## multimedia/tvheadend/Config.in
```kconfig
config TVHEADEND_CWC_SUPPORT
	bool "CWC support"
	default n

config TVHEADEND_LINUXDVB_SUPPORT
	bool "Linux DVB support"
	default n

config TVHEADEND_DVBSCAN_SUPPORT
	bool "Fetch DVB-scan data"
	depends on TVHEADEND_LINUXDVB_SUPPORT
	default TVHEADEND_LINUXDVB_SUPPORT

config TVHEADEND_AVAHI_SUPPORT
	bool "Avahi client support"
	select PACKAGE_libavahi-client
	default n

config TVHEADEND_SATIP_SUPPORT
	bool "SAT->IP support"
	default n

config TVHEADEND_TIMESHIFT_SUPPORT
	bool "Timeshift support"
	default y

config TVHEADEND_HDHOMERUN_SUPPORT
	bool "HDHomeRun support"
	default n
```
